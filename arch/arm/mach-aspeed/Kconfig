## arch/arm/mach-aspeed/Kconfig
```kconfig
if ARCH_ASPEED

config SYS_ARCH
	default "arm"

config SYS_SOC
	default "aspeed"

config ASPEED_AST2500
	bool "Support Aspeed AST2500 SoC"
	select CPU_ARM1176
	help
	  The Aspeed AST2500 is a ARM-based SoC with arm1176 CPU

endif
```

## arch/arm/mach-aspeed/ast2500/Kconfig
```kconfig
if ASPEED_AST2500

config SYS_CPU
	default "arm1176"

config TARGET_EVB_AST2500
	bool "Evb-AST2500"
	help
	  Evb-AST2500 is Aspeed evaluation board for AST2500 chip.

source "board/aspeed/evb_ast2500/Kconfig"

endif
```

## board/aspeed/zaius_bmc/Kconfig
```kconfig
if TARGET_ZAIUS_BMC

config SYS_BOARD
	default "zaius_bmc"

config SYS_VENDOR
	default "aspeed"

config SYS_CONFIG_NAME
	default "zaius_bmc"

endif
```

## configs/evb-ast2500_defconfig
```kconfig
CONFIG_ARM=y
CONFIG_ARCH_ASPEED=y
CONFIG_ASPEED_AST2500=y
CONFIG_TARGET_EVB_AST2500=y
CONFIG_DEFAULT_DEVICE_TREE="ast2500-evb"
CONFIG_OF_CONTROL=y
CONFIG_DM=y
CONFIG_SYS_MALLOC_F_LEN=0x2000
CONFIG_BOOTDELAY=5
CONFIG_DM_SPI=y
CONFIG_DM_SPI_FLASH=y
CONFIG_MTD=y
CONFIG_DISPLAY_CPUINFO=n
CONFIG_DEBUG_UART=y
CONFIG_DEBUG_UART_BASE=0x1e784000
CONFIG_DEBUG_UART_CLOCK=24000000
CONFIG_DEBUG_UART_NS16550=y
CONFIG_BAUDRATE=115200
CONFIG_SYS_NS16550=y
CONFIG_SYSRESET=y
CONFIG_CLK=y
CONFIG_TIMER=y
CONFIG_RAM=y
CONFIG_REGMAP=y
CONFIG_PRE_CONSOLE_BUFFER=y
CONFIG_PRE_CON_BUF_ADDR=0x1e720000
CONFIG_PRE_CON_BUF_SZ=2048
```

## configs/zaius_bmc_defconfig
```kconfig
CONFIG_ARM=y
CONFIG_DEFAULT_DEVICE_TREE="aspeed-zaius"
CONFIG_TARGET_ZAIUS_BMC=y
CONFIG_SPI_FLASH=y
CONFIG_SYS_NS16550=y
CONFIG_SYS_PROMPT="zaius> "
CONFIG_CMD_SAVEENV=y
CONFIG_CMD_FLASH=y
CONFIG_CMD_NET=y
CONFIG_CMD_PING=y
CONFIG_CMD_DHCP=y
CONFIG_DM=y
CONFIG_DM_I2C=y
CONFIG_CMD_I2C=y
CONFIG_OF_CONTROL=y
CONFIG_SYS_I2C_AST=y
```

## drivers/watchdog/Kconfig
```kconfig
menu "Watchdot Timer Support"

config WDT
	bool "Enable driver model for watchdog timer drivers"
	depends on DM
	help
	  Enable driver model for watchdog timer. At the moment the API
	  is very simple and only supports three operations:
	  start, restart and stop. The uclass is not concerned with
	  what happends when the timer expires, it is up to a particular
	  driver.

config WDT_ASPEED
	bool "Aspeed ast2400/ast2500 watchdog timer support"
	depends on WDT
	default y if ARCH_ASPEED
	help
	  Select this to enable watchdog timer for Aspeed ast2500/ast2400 devices.
	  The watchdog timer is stopped when initialized. It performs reset, either
	  full SoC reset or CPU or just some peripherals, based on the flags.
	  It currently does not support Boot Flash Addressing Mode Detection or
	  Second Boot.

endmenu
```
